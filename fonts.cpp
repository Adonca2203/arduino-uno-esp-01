#include "fonts.h"

const uint8_t FONT_A[8] PROGMEM = {0xFE, 0x11, 0x11, 0x11, 0x11, 0x11, 0xFE, 0x00};
const uint8_t FONT_B[8] PROGMEM = {0xFF, 0x89, 0x89, 0x89, 0x89, 0x76, 0x00, 0x00};
const uint8_t FONT_C[8] PROGMEM = {0x7E, 0x81, 0x81, 0x81, 0x81, 0x42, 0x00, 0x00};
const uint8_t FONT_D[8] PROGMEM = {0xFF, 0x81, 0x81, 0x81, 0x42, 0x3C, 0x00, 0x00};
const uint8_t FONT_E[8] PROGMEM = {0xFF, 0x89, 0x89, 0x89, 0x89, 0x81, 0x00, 0x00};
const uint8_t FONT_F[8] PROGMEM = {0xFF, 0x09, 0x09, 0x09, 0x09, 0x01, 0x00, 0x00};
const uint8_t FONT_G[8] PROGMEM = {0x7E, 0x81, 0x81, 0x91, 0x91, 0x72, 0x00, 0x00};
const uint8_t FONT_H[8] PROGMEM = {0xFF, 0x08, 0x08, 0x08, 0x08, 0xFF, 0x00, 0x00};
const uint8_t FONT_I[8] PROGMEM = {0x00, 0x81, 0xFF, 0x81, 0x00, 0x00, 0x00, 0x00};
const uint8_t FONT_J[8] PROGMEM = {0x40, 0x80, 0x80, 0x80, 0x7F, 0x00, 0x00, 0x00};
const uint8_t FONT_K[8] PROGMEM = {0xFF, 0x08, 0x14, 0x22, 0x41, 0x00, 0x00, 0x00};
const uint8_t FONT_L[8] PROGMEM = {0xFF, 0x80, 0x80, 0x80, 0x80, 0x80, 0x00, 0x00};
const uint8_t FONT_M[8] PROGMEM = {0xFF, 0x02, 0x04, 0x08, 0x04, 0x02, 0xFF, 0x00};
const uint8_t FONT_N[8] PROGMEM = {0xFF, 0x02, 0x04, 0x08, 0x10, 0xFF, 0x00, 0x00};
const uint8_t FONT_O[8] PROGMEM = {0x7E, 0x81, 0x81, 0x81, 0x81, 0x7E, 0x00, 0x00};
const uint8_t FONT_P[8] PROGMEM = {0xFF, 0x11, 0x11, 0x11, 0x11, 0x0E, 0x00, 0x00};
const uint8_t FONT_Q[8] PROGMEM = {0x7E, 0x81, 0x81, 0xA1, 0x41, 0xBE, 0x00, 0x00};
const uint8_t FONT_R[8] PROGMEM = {0xFF, 0x11, 0x11, 0x31, 0x51, 0x8E, 0x00, 0x00};
const uint8_t FONT_S[8] PROGMEM = {0x46, 0x89, 0x89, 0x89, 0x91, 0x62, 0x00, 0x00};
const uint8_t FONT_T[8] PROGMEM = {0x01, 0x01, 0xFF, 0x01, 0x01, 0x00, 0x00, 0x00};
const uint8_t FONT_U[8] PROGMEM = {0x7F, 0x80, 0x80, 0x80, 0x80, 0x7F, 0x00, 0x00};
const uint8_t FONT_V[8] PROGMEM = {0x1F, 0x20, 0x40, 0x80, 0x40, 0x20, 0x1F, 0x00};
const uint8_t FONT_W[8] PROGMEM = {0x7F, 0x80, 0x40, 0x30, 0x40, 0x80, 0x7F, 0x00};
const uint8_t FONT_X[8] PROGMEM = {0xC3, 0x24, 0x18, 0x18, 0x24, 0xC3, 0x00, 0x00};
const uint8_t FONT_Y[8] PROGMEM = {0x07, 0x08, 0xF0, 0x08, 0x07, 0x00, 0x00, 0x00};
const uint8_t FONT_Z[8] PROGMEM = {0xC1, 0xA1, 0x91, 0x89, 0x85, 0x83, 0x00, 0x00};

const uint8_t FONT_0[8] PROGMEM = {0x7E, 0xA1, 0x91, 0x89, 0x85, 0x7E, 0x00, 0x00};
const uint8_t FONT_1[8] PROGMEM = {0x00, 0x82, 0xFF, 0x80, 0x00, 0x00, 0x00, 0x00};
const uint8_t FONT_2[8] PROGMEM = {0xC2, 0xA1, 0x91, 0x89, 0x86, 0x00, 0x00, 0x00};
const uint8_t FONT_3[8] PROGMEM = {0x42, 0x81, 0x89, 0x89, 0x76, 0x00, 0x00, 0x00};
const uint8_t FONT_4[8] PROGMEM = {0x18, 0x14, 0x12, 0xFF, 0x10, 0x00, 0x00, 0x00};
const uint8_t FONT_5[8] PROGMEM = {0x4F, 0x89, 0x89, 0x89, 0x71, 0x00, 0x00, 0x00};
const uint8_t FONT_6[8] PROGMEM = {0x7E, 0x89, 0x89, 0x89, 0x70, 0x00, 0x00, 0x00};
const uint8_t FONT_7[8] PROGMEM = {0x01, 0x01, 0xF1, 0x09, 0x07, 0x00, 0x00, 0x00};
const uint8_t FONT_8[8] PROGMEM = {0x76, 0x89, 0x89, 0x89, 0x76, 0x00, 0x00, 0x00};
const uint8_t FONT_9[8] PROGMEM = {0x0E, 0x91, 0x91, 0x91, 0x7E, 0x00, 0x00, 0x00};

const uint8_t FONT_SPACE[8] PROGMEM = {0x00, 0x00, 0x00, 0x00, 0x00, 0x00, 0x00, 0x00};
const uint8_t FONT_EXCLAMATION[8] PROGMEM = {0x00, 0x00, 0xBF, 0x00, 0x00, 0x00, 0x00, 0x00};
const uint8_t FONT_QUESTION[8] PROGMEM = {0x02, 0x01, 0xB1, 0x09, 0x06, 0x00, 0x00, 0x00};
const uint8_t FONT_ASTERISK[8] PROGMEM = {0x00, 0x22, 0x14, 0x7F, 0x14, 0x22, 0x00, 0x00};
const uint8_t FONT_DASH[8] PROGMEM = {0x18, 0x18, 0x18, 0x18, 0x18, 0x18, 0x00, 0x00};
const uint8_t FONT_DEGREE[8] PROGMEM = {0x0E, 0x11, 0x11, 0x0E, 0x00, 0x00, 0x00, 0x00};
const uint8_t FONT_PERIOD[8] PROGMEM = {0x80, 0x00, 0x00, 0x00, 0x00, 0x00, 0x00, 0x00} ;

const uint8_t* getCharBitmap(char c) {
  switch (c) {
    case 'A': case 'a': return FONT_A;
    case 'B': case 'b': return FONT_B;
    case 'C': case 'c': return FONT_C;
    case 'D': case 'd': return FONT_D;
    case 'E': case 'e': return FONT_E;
    case 'F': case 'f': return FONT_F;
    case 'G': case 'g': return FONT_G;
    case 'H': case 'h': return FONT_H;
    case 'I': case 'i': return FONT_I;
    case 'J': case 'j': return FONT_J;
    case 'K': case 'k': return FONT_K;
    case 'L': case 'l': return FONT_L;
    case 'M': case 'm': return FONT_M;
    case 'N': case 'n': return FONT_N;
    case 'O': case 'o': return FONT_O;
    case 'P': case 'p': return FONT_P;
    case 'Q': case 'q': return FONT_Q;
    case 'R': case 'r': return FONT_R;
    case 'S': case 's': return FONT_S;
    case 'T': case 't': return FONT_T;
    case 'U': case 'u': return FONT_U;
    case 'V': case 'v': return FONT_V;
    case 'W': case 'w': return FONT_W;
    case 'X': case 'x': return FONT_X;
    case 'Y': case 'y': return FONT_Y;
    case 'Z': case 'z': return FONT_Z;
    
    case '0': return FONT_0;
    case '1': return FONT_1;
    case '2': return FONT_2;
    case '3': return FONT_3;
    case '4': return FONT_4;
    case '5': return FONT_5;
    case '6': return FONT_6;
    case '7': return FONT_7;
    case '8': return FONT_8;
    case '9': return FONT_9;
    
    case '*': return FONT_ASTERISK;
    case '-': return FONT_DASH;
    case '.': return FONT_PERIOD;
    case '!': return FONT_EXCLAMATION;
    case '?': return FONT_QUESTION;
    case ' ': return FONT_SPACE;
    
    default: return FONT_SPACE;
  }
}

const uint8_t* getDegree() {
  return FONT_DEGREE;
}

char digitToChar(uint8_t digit) {
  switch (digit) {
    case 0: return '0';
    case 1: return '1';
    case 2: return '2';
    case 3: return '3';
    case 4: return '4';
    case 5: return '5';
    case 6: return '6';
    case 7: return '7';
    case 8: return '8';
    case 9: return '9';
    default: return '?';
  }
}

int numberToDigits(uint32_t num, uint8_t digits[], int maxDigits) {
  int count = 0;
  
  if (num == 0) {
    digits[0] = 0;
    return 1;
  }
  
  uint32_t temp = num;
  while (temp > 0 && count < maxDigits) {
    digits[count] = temp % 10;
    temp /= 10;
    count++;
  }
  
  for (int i = 0; i < count / 2; i++) {
    uint8_t swap = digits[i];
    digits[i] = digits[count - 1 - i];
    digits[count - 1 - i] = swap;
  }
  
  return count;
}